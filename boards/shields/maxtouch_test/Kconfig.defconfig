## boards/shields/maxtouch_test/Kconfig.defconfig
```kconfig
# Copyright (c) 2024 The ZMK Contributors
# SPDX-License-Identifier: MIT

if SHIELD_MAXTOUCH_TEST

config ZMK_KEYBOARD_NAME
    default "maXTouch Test"

endif
```

## config/west.yml
```yaml
manifest:
  remotes:
    - name: zmkfirmware
      url-base: https://github.com/zmkfirmware
    - name: eleask
      url-base: https://github.com/E-Leask
  projects:
    - name: zmk
      remote: zmkfirmware
      revision: main
      import: app/west.yml
    - name: zmk-driver-maxtouch
      remote: eleask
      revision: main
  self:
    path: config
```
